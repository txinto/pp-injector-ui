## components/OTA/Kconfig.projbuild
```kconfig
menu "OTA settings"

config PORIS_ENABLE_OTA
    bool "Enable component OTA"
    default y
    help
      Enable/disable component OTA at Kconfig level.
      Variant gating is handled by environment variables (PORIS_ENABLE_OTA).

choice OTA_PIN_CORE
    prompt "Pin task to core"
    default OTA_PIN_CORE_ANY
    depends on OTA_USE_THREAD
    help
      Choose which core to pin the task to (or none).
config OTA_PIN_CORE_ANY
    bool "Any core (no affinity)"
config OTA_PIN_CORE_0
    bool "Core 0"
config OTA_PIN_CORE_1
    bool "Core 1"
endchoice

config OTA_TASK_STACK
    int "Task stack size (bytes)"
    range 8192 65536
    default 8192

config OTA_TASK_PRIO
    int "Task priority"
    range 1 24
    default 5

    config OTA_FIRMWARE_UPGRADE_URL
        string "Firmware Upgrade URL"
        default "https://gitlab.com/txinto/public/-/raw/main/firmware/esp32c6_devkit_poris_base.bin"
        help
            URL of server which hosts the firmware image.

    config OTA_FWSERVER_URL
        bool "Enable FwServer-like URLs"
        default n
        help
            Enable/disable building the download URL to be compatible with fwserver
        depends on PORIS_ENABLE_OTA

    config OTA_FWSERVER_MODEL
        string "Model for FwServer URL"
        default "POR"
        help
            Model for the FwServer URL arguments
        depends on OTA_FWSERVER_URL

    config OTA_FIRMWARE_UPGRADE_URL_FROM_STDIN
        bool
        default y if OTA_FIRMWARE_UPGRADE_URL = "FROM_STDIN"

    config OTA_SKIP_COMMON_NAME_CHECK
        bool "Skip server certificate CN fieldcheck"
        default n
        help
            This allows you to skip the validation of OTA server certificate CN field.

    config OTA_SKIP_VERSION_CHECK
        bool "Skip firmware version check"
        default n
        help
            This allows you to skip the firmware version check.

    config OTA_RECV_TIMEOUT
        int "OTA Receive Timeout"
        default 5000
        help
            Maximum time for reception

    config OTA_ENABLE_PARTIAL_HTTP_DOWNLOAD
        bool "Enable partial HTTP download"
        default n
        help
            This enables use of Range header in esp_https_ota component.
            Firmware image will be downloaded over multiple HTTP requests.

    config OTA_HTTP_REQUEST_SIZE
        int "HTTP request size"
        default MBEDTLS_SSL_IN_CONTENT_LEN
        depends on OTA_ENABLE_PARTIAL_HTTP_DOWNLOAD
        help
            This options specifies HTTP request size. Number of bytes specified
            in this option will be downloaded in single HTTP request.


endmenu
```

## components/PPInjectorUI/Kconfig.projbuild
```kconfig
menu "PPInjectorUI settings"

config PORIS_ENABLE_PPINJECTORUI
    bool "Enable component PPInjectorUI"
    default y
    help
      Enable/disable component PPInjectorUI at Kconfig level.
      Variant gating is handled by environment variables (PORIS_ENABLE_PPINJECTORUI).

config PPINJECTORUI_USE_THREAD
    bool "PPInjectorUI starts its own thread (PPInjectorUI starts its own thread)"
    default n
    help
      If enabled, PPInjectorUI will create a FreeRTOS task and call spin()
      periodically. If disabled, call PPInjectorUI_spin() yourself from
      your scheduler.
    depends on PORIS_ENABLE_PPINJECTORUI

config PPINJECTORUI_PERIOD_MS
    int "PPInjectorUI period (ms)"
    range 10 600000
    default 1000
    depends on PPINJECTORUI_USE_THREAD

config PPINJECTORUI_MINIMIZE_JITTER
    bool "Enable jitter minimization for execution cycles"
    default y
    help
      If active, the delay between loops will use vTaskDelayUntil() to guarantee long cycles will not shift the period, minimizing jitter.
      If deactivate, the component will use vTaskDelay() so the time it wait between cycles is the period.  Long cycles will introduce a shift in the period.
    depends on PPINJECTORUI_USE_THREAD

choice PPINJECTORUI_PIN_CORE
    prompt "Pin task to core"
    default PPINJECTORUI_PIN_CORE_ANY
    depends on PPINJECTORUI_USE_THREAD
    help
      Choose which core to pin the task to (or none).
config PPINJECTORUI_PIN_CORE_ANY
    bool "Any core (no affinity)"
config PPINJECTORUI_PIN_CORE_0
    bool "Core 0"
config PPINJECTORUI_PIN_CORE_1
    bool "Core 1"
endchoice

config PPINJECTORUI_TASK_STACK
    int "Task stack size (bytes)"
    range 2048 65536
    default 4096
    depends on PPINJECTORUI_USE_THREAD

config PPINJECTORUI_TASK_PRIO
    int "Task priority"
    range 1 24
    default 5
    depends on PPINJECTORUI_USE_THREAD

config PPINJECTORUI_UART_ENABLE
    bool "Enable UART machine link"
    default n
    depends on PORIS_ENABLE_PPINJECTORUI
    help
      Enable UART transport for PPInjectorUI machine protocol.

config PPINJECTORUI_UART_PORT
    int "UART port number"
    range 0 2
    default 1
    depends on PPINJECTORUI_UART_ENABLE
    help
      ESP-IDF UART port index.

config PPINJECTORUI_UART_BAUD
    int "UART baudrate"
    range 1200 2000000
    default 115200
    depends on PPINJECTORUI_UART_ENABLE

config PPINJECTORUI_UART_TX_GPIO
    int "UART TX GPIO"
    range -1 48
    default 44
    depends on PPINJECTORUI_UART_ENABLE
    help
      Waveshare 4.3B RS485 TX default is GPIO44.

config PPINJECTORUI_UART_RX_GPIO
    int "UART RX GPIO"
    range -1 48
    default 43
    depends on PPINJECTORUI_UART_ENABLE
    help
      Waveshare 4.3B RS485 RX default is GPIO43.

config PPINJECTORUI_UART_RX_BUF_SIZE
    int "UART RX driver buffer size"
    range 256 8192
    default 1024
    depends on PPINJECTORUI_UART_ENABLE

config PPINJECTORUI_UART_TX_BUF_SIZE
    int "UART TX driver buffer size"
    range 0 8192
    default 0
    depends on PPINJECTORUI_UART_ENABLE

config PPINJECTORUI_ENABLE_PRD_UI
    bool "Enable PPInjectorUI PrdUi layer"
    default y
    depends on PORIS_ENABLE_PPINJECTORUI
    help
      Enables the PrdUi layer (mould/common UI runtime on top of EEZ screens).
      Can be disabled temporarily during incremental bring-up/debug.

config PPINJECTORUI_KEYBOARD_DYNAMIC_ANCHOR
    bool "Adaptive keyboard anchor (top/bottom by focused field)"
    default y
    depends on PPINJECTORUI_ENABLE_PRD_UI
    help
      When enabled, PPInjectorUI aligns the keyboard at the bottom for fields
      in the upper half of the screen and at the top for fields in the lower
      half. This helps avoid covering the active field.

config PPINJECTORUI_STORAGE_SELFTEST
    bool "Run PPInjectorUI storage self-test at boot"
    default n
    depends on PORIS_ENABLE_PPINJECTORUI
    help
      Writes 3 synthetic mould profiles to SPIFFS, reloads them and logs a dump.
      This test is independent from PrdUi screen activation.

endmenu
```

## components/PrjCfg/Kconfig.projbuild
```kconfig
menu "PrjCfg settings"

config PORIS_ENABLE_PRJCFG
    bool "Enable component PrjCfg"
    default y
    help
      Enable/disable component PrjCfg at Kconfig level.
      Variant gating is handled by environment variables (PORIS_ENABLE_PRJCFG).

config PRJCFG_USE_THREAD
    bool "PrjCfg starts its own thread (PrjCfg starts its own thread)"
    default n
    help
      If enabled, PrjCfg will create a FreeRTOS task and call spin()
      periodically. If disabled, call PrjCfg_spin() yourself from
      your scheduler.
    depends on PORIS_ENABLE_PRJCFG

config PRJCFG_PERIOD_MS
    int "PrjCfg period (ms)"
    range 10 600000
    default 1000
    depends on PRJCFG_USE_THREAD

config PRJCFG_MINIMIZE_JITTER
    bool "Enable jitter minimization for execution cycles"
    default y
    help
      If active, the delay between loops will use vTaskDelayUntil() to guarantee long cycles will not shift the period, minimizing jitter.
      If deactivate, the component will use vTaskDelay() so the time it wait between cycles is the period.  Long cycles will introduce a shift in the period.
    depends on PRJCFG_USE_THREAD

choice PRJCFG_PIN_CORE
    prompt "Pin task to core"
    default PRJCFG_PIN_CORE_ANY
    depends on PRJCFG_USE_THREAD
    help
      Choose which core to pin the task to (or none).
config PRJCFG_PIN_CORE_ANY
    bool "Any core (no affinity)"
config PRJCFG_PIN_CORE_0
    bool "Core 0"
config PRJCFG_PIN_CORE_1
    bool "Core 1"
endchoice

config PRJCFG_TASK_STACK
    int "Task stack size (bytes)"
    range 2048 65536
    default 4096
    depends on PRJCFG_USE_THREAD

config PRJCFG_TASK_PRIO
    int "Task priority"
    range 1 24
    default 5
    depends on PRJCFG_USE_THREAD

endmenu
```

## components/Provisioning/Kconfig.projbuild
```kconfig
menu "Provisioning settings"

config PORIS_ENABLE_PROVISIONING
    bool "Enable component Provisioning"
    default y
    help
      Enable/disable component Provisioning at Kconfig level.
      Variant gating is handled by environment variables (PORIS_ENABLE_PROVISIONING).

config PROVISIONING_USE_THREAD
    bool "Provisioning starts its own thread (Provisioning starts its own thread)"
    default n
    help
      If enabled, Provisioning will create a FreeRTOS task and call spin()
      periodically. If disabled, call Provisioning_spin() yourself from
      your scheduler.
    depends on PORIS_ENABLE_PROVISIONING

config PROVISIONING_AUTOSTART_IF_NOT_PROVISIONED
    bool "Auto-start provisioning on boot when device is not provisioned"
    default y
    help
      If enabled, boot will start provisioning transport (BLE/SoftAP) when the
      device has no stored Wi-Fi credentials. Disable this to keep boot RAM usage
      lower and let the application run without provisioning/wifi.
    depends on PORIS_ENABLE_PROVISIONING

config PROVISIONING_PERIOD_MS
    int "Provisioning period (ms)"
    range 10 600000
    default 1000
    depends on PROVISIONING_USE_THREAD

config PROVISIONING_MINIMIZE_JITTER
    bool "Enable jitter minimization for execution cycles"
    default y
    help
      If active, the delay between loops will use vTaskDelayUntil() to guarantee long cycles will not shift the period, minimizing jitter.
      If deactivate, the component will use vTaskDelay() so the time it wait between cycles is the period.  Long cycles will introduce a shift in the period.
    depends on PROVISIONING_USE_THREAD

choice PROVISIONING_PIN_CORE
    prompt "Pin task to core"
    default PROVISIONING_PIN_CORE_ANY
    depends on PROVISIONING_USE_THREAD
    help
      Choose which core to pin the task to (or none).
config PROVISIONING_PIN_CORE_ANY
    bool "Any core (no affinity)"
config PROVISIONING_PIN_CORE_0
    bool "Core 0"
config PROVISIONING_PIN_CORE_1
    bool "Core 1"
endchoice

config PROVISIONING_TASK_STACK
    int "Task stack size (bytes)"
    range 2048 65536
    default 4096
    depends on PROVISIONING_USE_THREAD

config PROVISIONING_TASK_PRIO
    int "Task priority"
    range 1 24
    default 5
    depends on PROVISIONING_USE_THREAD

endmenu
menu "Provisioning Configuration"

    choice PROV_TRANSPORT
        bool "Provisioning Transport"
        default PROV_TRANSPORT_SOFTAP if IDF_TARGET_ESP32S2
        default PROV_TRANSPORT_BLE
        help
            Wi-Fi provisioning component offers both, SoftAP and BLE transports. Choose any one.

        config PROV_TRANSPORT_BLE
            bool "BLE"
            select BT_ENABLED
            depends on !IDF_TARGET_ESP32S2
        config PROV_TRANSPORT_SOFTAP
            bool "Soft AP"
            select LWIP_IPV4
    endchoice

    choice PROV_SECURITY_VERSION
        bool "Protocomm security version"
        default PROV_SECURITY_VERSION_2
        help
            Wi-Fi provisioning component offers 3 security versions.
            The example offers a choice between security version 1 and 2.

        config PROV_SECURITY_VERSION_1
            bool "Security version 1"
            select ESP_PROTOCOMM_SUPPORT_SECURITY_VERSION_1

        config PROV_SECURITY_VERSION_2
            bool "Security version 2"
            select ESP_PROTOCOMM_SUPPORT_SECURITY_VERSION_2
    endchoice

    choice PROV_MODE
        bool "Security version 2 mode"
        depends on PROV_SECURITY_VERSION_2
        default PROV_PROV_SEC2_DEV_MODE

        config PROV_PROV_SEC2_DEV_MODE
            bool "Security version 2 development mode"
            depends on PROV_SECURITY_VERSION_2
            help
                This enables the development mode for
                security version 2.
                Please note that this mode is NOT recommended for production purpose.

        config PROV_PROV_SEC2_PROD_MODE
            bool "Security version 2 production mode"
            depends on PROV_SECURITY_VERSION_2
            help
                This enables the production mode for
                security version 2.
    endchoice

    config PROV_TRANSPORT
        int
        default 1 if PROV_TRANSPORT_BLE
        default 2 if PROV_TRANSPORT_SOFTAP

    config PROV_RESET_PROVISIONED
        bool
        default n
        prompt "Reset provisioned status of the device"
        help
            This erases the NVS to reset provisioned status of the device on every reboot.
            Provisioned status is determined by the Wi-Fi STA configuration, saved on the NVS.

    config PROV_RESET_PROV_MGR_ON_FAILURE
        bool
        default y
        prompt "Reset provisioned credentials and state machine after session failure"
        help
            Enable reseting provisioned credentials and state machine after session failure.
            This will restart the provisioning service after retries are exhausted.

    config PROV_MGR_MAX_RETRY_CNT
        int
        default 5
        prompt "Max retries before reseting provisioning state machine"
        depends on PROV_RESET_PROV_MGR_ON_FAILURE
        help
            Set the Maximum retry to avoid reconnecting to an inexistent AP or if credentials
            are misconfigured. Provisioned credentials are erased and internal state machine
            is reset after this threshold is reached.

    config PROV_SHOW_QR
        bool "Show provisioning QR code"
        default y
        help
            Show the QR code for provisioning.

    config PROV_USING_BLUEDROID
        bool
        depends on (BT_BLUEDROID_ENABLED && (IDF_TARGET_ESP32C3 || IDF_TARGET_ESP32S3))
        select BT_BLE_42_FEATURES_SUPPORTED
        default y
        help
            This enables BLE 4.2 features for Bluedroid.

    config PROV_REPROVISIONING
        bool "Re-provisioning"
        help
            Enable re-provisioning - allow the device to provision for new credentials
            after previous successful provisioning.

endmenu
```
